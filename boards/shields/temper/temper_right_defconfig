## boards/shields/temper/temper_right_defconfig
```kconfig
# Uncomment the following line to enable deep sleep
CONFIG_ZMK_SLEEP=y
CONFIG_ZMK_PM=y
CONFIG_PM=y
CONFIG_PM_DEVICE=y
CONFIG_ZMK_IDLE_TIMEOUT=5000
CONFIG_ZMK_IDLE_SLEEP_TIMEOUT=10000
#CONFIG_ZMK_IDLE_SLEEP_TIMEOUT=300000

CONFIG_ZMK_DISPLAY_WORK_QUEUE_DEFERRED=y
CONFIG_ZMK_DISPLAY=y
CONFIG_ZMK_DISPLAY_STATUS_SCREEN_TIMEOUT=30000
CONFIG_ZMK_SPLIT=y

CONFIG_BT_DEVICE_NAME="Temper"
```
